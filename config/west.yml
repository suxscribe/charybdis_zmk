## config/west.yml
```yaml
manifest:
  remotes:
    - name: zmkfirmware
      url-base: https://github.com/petejohanson
    # - name: badjeff
    #   url-base: https://github.com/badjeff
    - name: inorichi
      url-base: https://github.com/inorichi
  projects:
    - name: zmk
      remote: zmkfirmware
      revision: feat/pointers-move-scroll
      import: app/west.yml
    - name: zmk-pmw3610-driver
      remote: inorichi
      revision: main
    # - name: zmk
    #   remote: zmkfirmware
    #   revision: feat/pointers-with-input-processors
    #   import: app/west.yml
    # - name: zmk-pmw3610-driver
    #   remote: badjeff
    #   revision: main
    # - name: zmk-split-peripheral-input-relay
    #   remote: badjeff
    #   revision: main
    # - name: zmk-input-behavior-listener
    #   remote: badjeff
    #   revision: main
  self:
    path: config
```
